/*                KEY POSITIONS

  ╭──────────────╮ ╭──────────────╮
  │ LT4 LT3 LT2 LT1 LT0 │ │ RT0 RT1 RT2 RT3 RT4 │
  │ LM4 LM3 LM2 LM1 LM0 │ │ RM0 RM1 RM2 RM3 RM4 │
  │ LB4 LB3 LB2 LB1 LB0 │ │ RB0 RB1 RB2 RB3 RB4 │
  ╰────╮     LH1 LH0 │ │ RH0 RH1     ╭────╯
          ╰────────╯ ╰───╯ */

#define COMBO_TERM_FAST 50
#define COMBO_TERM_SLOW 30

#define COMBO_IDLE_FAST 150
#define COMBO_IDLE_SLOW 50

/**
 * Temporarily switches to a layer (`&mo`) while a modifier is held.
 * Analogous to QMK's `LM()`, using a parameterized macro.
 *
 * Params:
 *  Layer to switch to
 *
 * Example:
 *  `&lm NUM_LAYER `
 */
#define MODMO(NAME, MOD) \
/ { \
  macros { \
  NAME: NAME { \
      compatible = "zmk,behavior-macro-one-param"; \
      wait-ms = <0>; \
      tap-ms = <0>; \
      #binding-cells = <1>; \
      bindings \
        = <&macro_param_1to1> \
        , <&macro_press &mo MACRO_PLACEHOLDER> \
        , <&macro_press &kp MOD> \
        , <&macro_pause_for_release> \
        , <&macro_release &kp MOD> \
        , <&macro_param_1to1> \
        , <&macro_release &mo MACRO_PLACEHOLDER> \
        ; \
    }; \
  }; \
};

MODMO(mos, LSHIFT)
MODMO(moa, LALT)
MODMO(moc, LCTRL)

#define MAKE_HRML(NAME, HOLD, TAP, TRIGGER_POS)                                 \
  ZMK_HOLD_TAP(NAME, bindings = <HOLD>, <TAP>; flavor = "hold-preferred";            \
               tapping-term-ms = <280>; quick-tap-ms = <QUICK_TAP_MS>;         \
               require-prior-idle-ms = <150>; hold-trigger-on-release;         \
               hold-trigger-key-positions = <TRIGGER_POS>;)

MAKE_HRML(molc, &moc, &kp, KEYS_R THUMBS) // Left-hand HRMs.
MAKE_HRML(mola, &moa, &kp, KEYS_R THUMBS) // Right-hand HRMs.
MAKE_HRML(mols, &mos, &kp, KEYS_R THUMBS) // Right-hand HRMs.
MAKE_HRML(mora, &moa, &kp, KEYS_L THUMBS) // Left-hand HRMs.
MAKE_HRML(morc, &moc, &kp, KEYS_L THUMBS) // Right-hand HRMs.
MAKE_HRML(mors, &mos, &kp, KEYS_L THUMBS) // Right-hand HRMs.

#define ASF(NUMBER) &as F##NUMBER N##NUMBER     // AutoFn Macro

/ {
  macros {
  lm: lm {
      compatible = "zmk,behavior-macro-two-param";
      wait-ms = <0>;
      tap-ms = <0>;
      #binding-cells = <2>;
      bindings
        = <&macro_param_1to1>
        , <&macro_press &mo MACRO_PLACEHOLDER>
        , <&macro_param_2to1>
        , <&macro_press &kp MACRO_PLACEHOLDER>
        , <&macro_pause_for_release>
        , <&macro_param_2to1>
        , <&macro_release &kp MACRO_PLACEHOLDER>
        , <&macro_param_1to1>
        , <&macro_release &mo MACRO_PLACEHOLDER>
        ;
    };
  };
};


// Numbers
ZMK_COMBO(one,   AS(N1), LT4 LT3        , BASE, COMBO_TERM_FAST, COMBO_IDLE_FAST)
ZMK_COMBO(three, AS(N3),     LT3 LT2    , BASE, COMBO_TERM_FAST, COMBO_IDLE_FAST)
ZMK_COMBO(five,  AS(N5),         LT2 LT1, BASE, COMBO_TERM_FAST, COMBO_IDLE_FAST)

ZMK_COMBO(two,   AS(N2), LM4 LM3       , BASE, COMBO_TERM_FAST, COMBO_IDLE_FAST)
ZMK_COMBO(four,  AS(N4)       ,        LB2 LB1, BASE, COMBO_TERM_FAST, COMBO_IDLE_FAST)

ZMK_COMBO(six,   AS(N6), RT1 RT2        , BASE, COMBO_TERM_FAST, COMBO_IDLE_FAST)
ZMK_COMBO(eight, AS(N8),     RT2 RT3    , BASE, COMBO_TERM_FAST, COMBO_IDLE_FAST)
ZMK_COMBO(zero,  AS(N0),         RT3 RT4, BASE, COMBO_TERM_FAST, COMBO_IDLE_FAST)

ZMK_COMBO(nine,  AS(N9),          RM3 RM4, BASE, COMBO_TERM_FAST, COMBO_IDLE_FAST)
ZMK_COMBO(seven, AS(N7)         , RB1 RB2        , BASE, COMBO_TERM_FAST, COMBO_IDLE_FAST)

// Fn keys
ZMK_COMBO(f1,  &kp F1, LT4 LT3        , ALEFT, COMBO_TERM_FAST, COMBO_IDLE_FAST)
ZMK_COMBO(f3,  &kp F3,     LT3 LT2    , ALEFT, COMBO_TERM_FAST, COMBO_IDLE_FAST)
ZMK_COMBO(f5,  &kp F5,         LT2 LT1, ALEFT, COMBO_TERM_FAST, COMBO_IDLE_FAST)

ZMK_COMBO(f2,  &kp F2, LM4 LM3        , ALEFT, COMBO_TERM_FAST, COMBO_IDLE_FAST)
ZMK_COMBO(f4,  &kp F4,         LB2 LB1, ALEFT, COMBO_TERM_FAST, COMBO_IDLE_FAST)

ZMK_COMBO(f6,  &kp F6, RT1 RT2        , ARIGHT, COMBO_TERM_FAST, COMBO_IDLE_FAST)
ZMK_COMBO(f8,  &kp F8,     RT2 RT3    , ARIGHT, COMBO_TERM_FAST, COMBO_IDLE_FAST)
ZMK_COMBO(f10, &kp F10,        RT3 RT4, ARIGHT, COMBO_TERM_FAST, COMBO_IDLE_FAST)

ZMK_COMBO(f9,  &kp F9,         RM3 RM4, ARIGHT, COMBO_TERM_FAST, COMBO_IDLE_FAST)
ZMK_COMBO(f7,  &kp F7, RB1 RB2        , ARIGHT, COMBO_TERM_FAST, COMBO_IDLE_FAST)

// Left ----------------------------------------------------------------------------------------------------

// Left top
ZMK_COMBO(grave, AS(GRAVE),     LT4     LT2, BASE , COMBO_TERM_FAST, COMBO_IDLE_FAST)
ZMK_COMBO(pgdn,  &kp PAGE_DOWN, LT4         LT1, BASE , COMBO_TERM_FAST, COMBO_IDLE_FAST)
ZMK_COMBO(t,     AS(T),         LT3     LT1, BASE , COMBO_TERM_FAST, COMBO_IDLE_FAST)

// Left middle
ZMK_COMBO(tabl,   AS(TAB),                LM2 LM1, BASE , COMBO_TERM_FAST, COMBO_IDLE_FAST)
ZMK_COMBO(escl,   &kp ESC,            LM3 LM2    , BASE , COMBO_TERM_FAST, COMBO_IDLE_FAST)
ZMK_COMBO(caps,   &caps_word,               LM4     LM2    , BASE , COMBO_TERM_FAST, COMBO_IDLE_FAST) //both shifts for caps_word
ZMK_COMBO(left,   &kp LEFT,       LM4          LM1, BASE , COMBO_TERM_FAST, COMBO_IDLE_FAST)
ZMK_COMBO(g,      AS(G),             LM3     LM1, BASE , COMBO_TERM_FAST, COMBO_IDLE_FAST)

// Left bottom
ZMK_COMBO(end,    &kp END,       LB3 LB2   , BASE , COMBO_TERM_FAST, COMBO_IDLE_FAST)
ZMK_COMBO(home,   &kp HOME,  LB4 LB3       , BASE , COMBO_TERM_FAST, COMBO_IDLE_FAST)
ZMK_COMBO(leaderl, &leader,   LB4    LB2    , BASE , COMBO_TERM_FAST, COMBO_IDLE_FAST)
ZMK_COMBO(down ,  &kp DOWN,  LB4        LB1, BASE , COMBO_TERM_FAST, COMBO_IDLE_FAST)
ZMK_COMBO(b,      &kp B,         LB3    LB1, BASE , COMBO_TERM_FAST, COMBO_IDLE_FAST)

//Mods
ZMK_COMBO(mod_ls,  &kp LSHIFT, LH1 LM4, BASE, COMBO_TERM_FAST, COMBO_IDLE_FAST)
ZMK_COMBO(mod_lr,  &mo ARIGHT, LH1     LM3, BASE, COMBO_TERM_FAST, COMBO_IDLE_FAST)
ZMK_COMBO(mod_la,  &kp LALT,   LH1         LM2, BASE, COMBO_TERM_FAST, COMBO_IDLE_FAST)
ZMK_COMBO(mod_lc,  &kp LCTRL,  LH1             LM1, BASE, COMBO_TERM_FAST, COMBO_IDLE_FAST)

ZMK_COMBO(mod_la,    &kp LALT,           LH1     LM2        , BASE, COMBO_TERM_FAST, COMBO_IDLE_FAST)
ZMK_COMBO(mod_lar,   &lm ALEFT LC(LALT), LH1     LM2 LM3    , BASE, COMBO_TERM_FAST, COMBO_IDLE_FAST)
ZMK_COMBO(mod_las,   &kp LS(LALT),       LH1     LM2     LM4, BASE, COMBO_TERM_FAST, COMBO_IDLE_FAST)
ZMK_COMBO(mod_lr,    &mo ALEFT,          LH1         LM3    , BASE, COMBO_TERM_FAST, COMBO_IDLE_FAST)
ZMK_COMBO(mod_lrs,   &lm ALEFT LSHIFT,   LH1         LM3 LM4, BASE, COMBO_TERM_FAST, COMBO_IDLE_FAST)
ZMK_COMBO(mod_ls,    &kp LSHIFT,         LH1             LM4, BASE, COMBO_TERM_FAST, COMBO_IDLE_FAST)

ZMK_COMBO(mod_lars ,    &lm ALEFT LA(LSHIFT),     LH1     LM2 LM3 LM4, BASE, COMBO_TERM_FAST, COMBO_IDLE_FAST)
ZMK_COMBO(mod_lcrs ,    &lm ALEFT LC(LSHIFT),     LH1 LM1     LM3 LM4, BASE, COMBO_TERM_FAST, COMBO_IDLE_FAST)
ZMK_COMBO(mod_lcas,     &kp LC(LA(LSHIFT)),       LH1 LM1 LM2     LM4, BASE, COMBO_TERM_FAST, COMBO_IDLE_FAST)
ZMK_COMBO(mod_lcar ,    &lm ALEFT LC(LALT),            LH1 LM1 LM2 LM3    , BASE, COMBO_TERM_FAST, COMBO_IDLE_FAST)
ZMK_COMBO(mod_lcars,    &lm ALEFT LC(LA(LSHIFT)), LH1 LM1 LM2 LM3 LM4, BASE, COMBO_TERM_FAST, COMBO_IDLE_FAST)

ZMK_COMBO(mod_lg,   &kp LGUI, LH1 LB1, BASE, COMBO_TERM_FAST, COMBO_IDLE_FAST)
ZMK_COMBO(mod_lag,  &kp LA(LGUI), LH1 LB1 LM2, BASE, COMBO_TERM_FAST, COMBO_IDLE_FAST)
ZMK_COMBO(mod_lsg,  &kp LS(LGUI), LH1 LB1 LM4, BASE, COMBO_TERM_FAST, COMBO_IDLE_FAST)
ZMK_COMBO(mod_lrg,  &lm ALEFT LGUI, LH1 LB1 LM3, BASE, COMBO_TERM_FAST, COMBO_IDLE_FAST)

// Right ----------------------------------------------------------------------------------------------------

// Right top
ZMK_COMBO(blash, &kp BACKSLASH,     RT2    RT4, BASE , COMBO_TERM_FAST, COMBO_IDLE_FAST)
ZMK_COMBO(pgup,  &kp PAGE_UP  , RT1        RT4, BASE , COMBO_TERM_FAST, COMBO_IDLE_FAST)
ZMK_COMBO(y,     AS(Y),         RT1    RT3    , BASE , COMBO_TERM_FAST, COMBO_IDLE_FAST)

// Right middle
ZMK_COMBO(retr,   &kp   RET,   RM1 RM2        , BASE , COMBO_TERM_FAST, COMBO_IDLE_FAST)
ZMK_COMBO(escr,   &kp    ESC,       RM2 RM3    , BASE  , COMBO_TERM_FAST, COMBO_IDLE_FAST)
ZMK_COMBO(sqt,    AS(SQT),      RM2     RM4, BASE , COMBO_TERM_FAST, COMBO_IDLE_FAST)
ZMK_COMBO(right,  &kp  RIGHT, RM1         RM4, BASE , COMBO_TERM_FAST, COMBO_IDLE_FAST)
ZMK_COMBO(h,      AS(H),     RM1     RM3    , BASE , COMBO_TERM_FAST, COMBO_IDLE_FAST)

ZMK_COMBO(f11,    &kp F11,   RM1 RM2        , ARIGHT, COMBO_TERM_FAST, COMBO_IDLE_FAST)
ZMK_COMBO(f12,    &kp F12,       RM2 RM3    , ARIGHT, COMBO_TERM_FAST, COMBO_IDLE_FAST)

// Right bottom
ZMK_COMBO(minus, AS(MINUS),     RB2 RB3    , BASE , COMBO_TERM_FAST, COMBO_IDLE_FAST)
ZMK_COMBO(equal, AS(EQUAL),         RB3 RB4, BASE , COMBO_TERM_FAST, COMBO_IDLE_FAST)

ZMK_COMBO(leaderr,  &leader,          RB2     RB4, BASE , COMBO_TERM_FAST, COMBO_IDLE_FAST)
ZMK_COMBO(up,    &kp UP , RB1         RB4, BASE , COMBO_TERM_FAST, COMBO_IDLE_FAST)
ZMK_COMBO(n,     &kp N,          RB1     RB3    , BASE , COMBO_TERM_FAST, COMBO_IDLE_FAST)

// Right cross
ZMK_COMBO(backspace, &kp BSPC, RM1 RT3, BASE , COMBO_TERM_FAST, COMBO_IDLE_FAST) //J + O
ZMK_COMBO(del,       &kp DELETE,    RM1 RT4, BASE , COMBO_TERM_FAST, COMBO_IDLE_FAST) //J + P
ZMK_COMBO(lbkt,       AS(LBKT),    RB1 RM3, BASE , COMBO_TERM_FAST, COMBO_IDLE_FAST) //M + K
ZMK_COMBO(rbkt,       AS(RBKT),    RB1 RM4, BASE , COMBO_TERM_FAST, COMBO_IDLE_FAST) //M + L

//Mods
ZMK_COMBO(mod_rc,    &kp LCTRL,          RH1 RM1            , BASE, COMBO_TERM_FAST, COMBO_IDLE_FAST)
ZMK_COMBO(mod_rca,   &kp LA(LCTRL),      RH1 RM1 RM2        , BASE, COMBO_TERM_FAST, COMBO_IDLE_FAST)
ZMK_COMBO(mod_rcr,   &lm ALEFT LCTRL,    RH1 RM1     RM3    , BASE, COMBO_TERM_FAST, COMBO_IDLE_FAST)
ZMK_COMBO(mod_rcs,   &kp LS(LCTRL),      RH1 RM1         RM4, BASE, COMBO_TERM_FAST, COMBO_IDLE_FAST)
ZMK_COMBO(mod_ra,    &kp LALT,           RH1     RM2        , BASE, COMBO_TERM_FAST, COMBO_IDLE_FAST)
ZMK_COMBO(mod_rar,   &lm ALEFT LC(LALT), RH1     RM2 RM3    , BASE, COMBO_TERM_FAST, COMBO_IDLE_FAST)
ZMK_COMBO(mod_ras,   &kp LS(LALT),       RH1     RM2     RM4, BASE, COMBO_TERM_FAST, COMBO_IDLE_FAST)
ZMK_COMBO(mod_rr,    &mo ALEFT,          RH1         RM3    , BASE, COMBO_TERM_FAST, COMBO_IDLE_FAST)
ZMK_COMBO(mod_rrs,   &lm ALEFT LSHIFT,   RH1         RM3 RM4, BASE, COMBO_TERM_FAST, COMBO_IDLE_FAST)
ZMK_COMBO(mod_rs,    &kp LSHIFT,         RH1             RM4, BASE, COMBO_TERM_FAST, COMBO_IDLE_FAST)

ZMK_COMBO(mod_rars ,    &lm ALEFT LA(LSHIFT),     RH1     RM2 RM3 RM4, BASE, COMBO_TERM_FAST, COMBO_IDLE_FAST)
ZMK_COMBO(mod_rcrs ,    &lm ALEFT LC(LSHIFT),     RH1 RM1     RM3 RM4, BASE, COMBO_TERM_FAST, COMBO_IDLE_FAST)
ZMK_COMBO(mod_rcas,     &kp LC(LA(LSHIFT)),       RH1 RM1 RM2     RM4, BASE, COMBO_TERM_FAST, COMBO_IDLE_FAST)
ZMK_COMBO(mod_rcar,     &lm ALEFT LC(LALT),       RH1 RM1 RM2 RM3    , BASE, COMBO_TERM_FAST, COMBO_IDLE_FAST)
ZMK_COMBO(mod_rcars,    &lm ALEFT LC(LA(LSHIFT)), RH1 RM1 RM2 RM3 RM4, BASE, COMBO_TERM_FAST, COMBO_IDLE_FAST)

ZMK_COMBO(mod_rg,    &kp LGUI, RH1 RB1, BASE, COMBO_TERM_FAST, COMBO_IDLE_FAST)
ZMK_COMBO(mod_rag,    &kp LA(LGUI), RH1 RB1 RM2, BASE, COMBO_TERM_FAST, COMBO_IDLE_FAST)
ZMK_COMBO(mod_rsg,    &kp LS(LGUI), RH1 RB1 RM4, BASE, COMBO_TERM_FAST, COMBO_IDLE_FAST)
ZMK_COMBO(mod_rrg,    &lm ARIGHT LGUI, RH1 RB1 LM3, BASE, COMBO_TERM_FAST, COMBO_IDLE_FAST)

// Both sides ====================================================================================================
ZMK_COMBO(bcaps,   &caps_word, LM4     RM4    , BASE, COMBO_TERM_FAST, COMBO_IDLE_FAST)

// Settings impossible combo
ZMK_COMBO(settingsl, &to SETTINGS, LT4 LT0 LB0, BASE BMIRROR, COMBO_TERM_FAST, COMBO_IDLE_FAST)
ZMK_COMBO(settingsr, &to SETTINGS, RT4 RT0 RB0, BASE BMIRROR, COMBO_TERM_FAST, COMBO_IDLE_FAST)

// TODO
// Mirrored ====================================================================================================

// Numbers
ZMK_COMBO(mone,   AS(N1), RT4 RT3        , BMIRROR, COMBO_TERM_FAST, COMBO_IDLE_FAST)
ZMK_COMBO(mthree, AS(N3),     RT3 RT2    , BMIRROR, COMBO_TERM_FAST, COMBO_IDLE_FAST)
ZMK_COMBO(mfive,  AS(N5),         RT2 RT1, BMIRROR, COMBO_TERM_FAST, COMBO_IDLE_FAST)

ZMK_COMBO(mtwo,   AS(N2), RM4 RM3       , BMIRROR, COMBO_TERM_FAST, COMBO_IDLE_FAST)
ZMK_COMBO(mfour,  AS(N4),        RB2 RB1, BMIRROR, COMBO_TERM_FAST, COMBO_IDLE_FAST)

ZMK_COMBO(msix,   AS(N6), LT1 LT2        , BMIRROR , COMBO_TERM_FAST, COMBO_IDLE_FAST)
ZMK_COMBO(meight, AS(N8),     LT2 LT3    , BMIRROR, COMBO_TERM_FAST, COMBO_IDLE_FAST)
ZMK_COMBO(mzero,  AS(N0),         LT3 LT4, BMIRROR, COMBO_TERM_FAST, COMBO_IDLE_FAST)

ZMK_COMBO(mnine,  AS(N9),          LM3 LM4, BMIRROR, COMBO_TERM_FAST, COMBO_IDLE_FAST)
ZMK_COMBO(mseven, AS(N7)         , LB1 LB2        , BMIRROR, COMBO_TERM_FAST, COMBO_IDLE_FAST)

// Right with mirrored left

// Right top
ZMK_COMBO(mgrave, &kp GRAVE,     RT4     RT2, BMIRROR, COMBO_TERM_FAST, COMBO_IDLE_FAST)
ZMK_COMBO(mpgdn,  &kp PAGE_DOWN, RT4         RT1, BMIRROR, COMBO_TERM_FAST, COMBO_IDLE_FAST)
ZMK_COMBO(mt,     &kp T,         RT3     RT1, BMIRROR, COMBO_TERM_FAST, COMBO_IDLE_FAST)

// Right middle
ZMK_COMBO(mtabl,   AS(TAB),                 RM2 RM1, BMIRROR, COMBO_TERM_FAST, COMBO_IDLE_FAST)
ZMK_COMBO(mescl,   &kp   ESC,             RM3 RM2    , BMIRROR, COMBO_TERM_FAST, COMBO_IDLE_FAST)
ZMK_COMBO(mcaps,   &hml  LS(LALT) &caps_word, RM4      RM2    , BMIRROR, COMBO_TERM_FAST, COMBO_IDLE_FAST)
ZMK_COMBO(mleft,   &hml LS(LCTRL) LEFT,       RM4         RM1, BMIRROR, COMBO_TERM_FAST, COMBO_IDLE_FAST)
ZMK_COMBO(mg,      &molc ARIGHT   G,               RM3     RM1, BMIRROR, COMBO_TERM_FAST, COMBO_IDLE_FAST)

// Right bottom
ZMK_COMBO(mend,    &kp END,       RB3 RB2   , BMIRROR, COMBO_TERM_FAST, COMBO_IDLE_FAST)
ZMK_COMBO(mhome,   &kp HOME,  RB4 RB3       , BMIRROR, COMBO_TERM_FAST, COMBO_IDLE_FAST)
ZMK_COMBO(mleader, &leader,   RB4    RB2    , BMIRROR, COMBO_TERM_FAST, COMBO_IDLE_FAST)
ZMK_COMBO(mdown ,  &kp DOWN,  RB4        RB1, BMIRROR, COMBO_TERM_FAST, COMBO_IDLE_FAST)
ZMK_COMBO(mb,      &kp B,         RB3    RB1, BMIRROR, COMBO_TERM_FAST, COMBO_IDLE_FAST)


// Left with mirrored right

// Left top
ZMK_COMBO(mblash, &kp BACKSLASH,     LT2    LT4, BMIRROR, COMBO_TERM_FAST, COMBO_IDLE_FAST)
ZMK_COMBO(mpgup,  &kp PAGE_UP  , LT1        LT4, BMIRROR, COMBO_TERM_FAST, COMBO_IDLE_FAST)
ZMK_COMBO(my,     &kp Y,         LT1    LT3    , BMIRROR, COMBO_TERM_FAST, COMBO_IDLE_FAST)

// Left middle
ZMK_COMBO(mretr,   &hmr LC(LALT)   RET,   LM1 LM2        , BMIRROR, COMBO_TERM_FAST, COMBO_IDLE_FAST)
ZMK_COMBO(mescr,   &mora ALEFT     ESC,       LM2 LM3    , BMIRROR , COMBO_TERM_FAST, COMBO_IDLE_FAST)
ZMK_COMBO(msqt,    &hmr LA(LSHIFT) SQT,      LM2     LM4 , BMIRROR, COMBO_TERM_FAST, COMBO_IDLE_FAST)
ZMK_COMBO(mright,  &hmr LS(LCTRL)  RIGHT, LM1         LM4, BMIRROR, COMBO_TERM_FAST, COMBO_IDLE_FAST)
ZMK_COMBO(mh,      &morc ALEFT     H,     LM1     LM3    , BMIRROR, COMBO_TERM_FAST, COMBO_IDLE_FAST)

// Left bottom
ZMK_COMBO(mminus, &kp MINUS,     LB2 LB3    , BMIRROR, COMBO_TERM_FAST, COMBO_IDLE_FAST)
ZMK_COMBO(mequal, &kp EQUAL,         LB3 LB4, BMIRROR, COMBO_TERM_FAST, COMBO_IDLE_FAST)
ZMK_COMBO(mrbkt,  &kp LBKT,      LB2     LB4, BMIRROR, COMBO_TERM_FAST, COMBO_IDLE_FAST)
ZMK_COMBO(mup,    &kp UP ,   LB1         LB4, BMIRROR, COMBO_TERM_FAST, COMBO_IDLE_FAST)
ZMK_COMBO(mn,     &kp N,     LB1     LB3    , BMIRROR, COMBO_TERM_FAST, COMBO_IDLE_FAST)

// Left cross
ZMK_COMBO(mbackspace, &kp BSPC, LM1 LT3, BMIRROR, COMBO_TERM_FAST, COMBO_IDLE_FAST) //J + O
ZMK_COMBO(mdel,       &kp DELETE,    LM1 LT4, BMIRROR, COMBO_TERM_FAST, COMBO_IDLE_FAST) //J + P
ZMK_COMBO(mlbkt,       &kp LBKT,    LB1 LM3, BMIRROR, COMBO_TERM_FAST, COMBO_IDLE_FAST) //M + K
ZMK_COMBO(mrbkt,       &kp RBKT,    LB1 LM4, BMIRROR, COMBO_TERM_FAST, COMBO_IDLE_FAST) //M + L
