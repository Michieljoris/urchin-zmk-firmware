#include <behaviors/unicode.dtsi>

&uc {
  default-mode = <UC_MODE_LINUX>;  // Replace with desired input system.
};

#undef ZMK_LEADER_SEQUENCE
#define ZMK_LEADER_SEQUENCE(name, leader_bindings, leader_sequence) \
    / { \
        behaviors { \
            leader: leader { \
                compatible = "zmk,behavior-leader-key"; \
                #binding-cells = <0>; \
                ignore-keys = <LSHFT RSHFT>; \
                leader_sequence_ ## name { \
                    bindings = <leader_bindings>; \
                    sequence = <leader_sequence>; \
                }; \
            }; \
        }; \
    };

/* German umlauts */
ZMK_LEADER_SEQUENCE(de_ae,      &uc UC_DE_AE,         A)  // ä
ZMK_LEADER_SEQUENCE(de_oe,      &uc UC_DE_OE,         O)  // ö
ZMK_LEADER_SEQUENCE(de_ue,      &uc UC_DE_UE,         U)  // ü
ZMK_LEADER_SEQUENCE(de_eszett,  &uc UC_DE_SS,         S)  // ß

/* Greek letters */
ZMK_LEADER_SEQUENCE(el_alpha,   &uc UC_EL_ALPHA,      E A)  // α
ZMK_LEADER_SEQUENCE(el_beta,    &uc UC_EL_BETA,       E B)  // β
ZMK_LEADER_SEQUENCE(el_gamma,   &uc UC_EL_GAMMA,      E G)  // γ
ZMK_LEADER_SEQUENCE(el_delta,   &uc UC_EL_DELTA,      E D)  // δ
ZMK_LEADER_SEQUENCE(el_epsilon, &uc UC_EL_EPSILON,    E E)  // ε
ZMK_LEADER_SEQUENCE(el_zeta,    &uc UC_EL_ZETA,       E Z)  // ζ
ZMK_LEADER_SEQUENCE(el_eta,     &uc UC_EL_ETA,        E H)  // η
ZMK_LEADER_SEQUENCE(el_theta,   &uc UC_EL_THETA,      E V)  // θ
ZMK_LEADER_SEQUENCE(el_iota,    &uc UC_EL_IOTA,       E I)  // ι
ZMK_LEADER_SEQUENCE(el_kappa,   &uc UC_EL_KAPPA,      E K)  // κ
ZMK_LEADER_SEQUENCE(el_lambda,  &uc UC_EL_LAMBDA,     E L)  // λ
ZMK_LEADER_SEQUENCE(el_mu,      &uc UC_EL_MU,         E M)  // μ
ZMK_LEADER_SEQUENCE(el_nu,      &uc UC_EL_NU,         E N)  // ν
ZMK_LEADER_SEQUENCE(el_xi,      &uc UC_EL_XI,         E X)  // ξ
ZMK_LEADER_SEQUENCE(el_omikron, &uc UC_EL_OMIKRON,    E O)  // ο
ZMK_LEADER_SEQUENCE(el_pi,      &uc UC_EL_PI,         E P)  // π
ZMK_LEADER_SEQUENCE(el_rho,     &uc UC_EL_RHO,        E R)  // ρ
ZMK_LEADER_SEQUENCE(el_sigma,   &uc UC_EL_SIGMA,      E S)  // σ
ZMK_LEADER_SEQUENCE(el_tau,     &uc UC_EL_TAU,        E T)  // τ
ZMK_LEADER_SEQUENCE(el_upsilon, &uc UC_EL_UPSILON,    E U)  // υ
ZMK_LEADER_SEQUENCE(el_phi,     &uc UC_EL_PHI,        E F)  // ϕ
ZMK_LEADER_SEQUENCE(el_chi,     &uc UC_EL_CHI,        E C)  // χ
ZMK_LEADER_SEQUENCE(el_psi,     &uc UC_EL_PSI,        E Y)  // ψ
ZMK_LEADER_SEQUENCE(el_omega,   &uc UC_EL_OMEGA,      E W)  // ω

// BLE and USB
#ifdef CONFIG_WIRELESS
ZMK_LEADER_SEQUENCE(usb,        &out OUT_USB,   U S B)
ZMK_LEADER_SEQUENCE(ble,        &out OUT_BLE,   B L E)

ZMK_LEADER_SEQUENCE(bts1,        &out BT_SEL 0,   B T S 1)
ZMK_LEADER_SEQUENCE(bts2,        &out BT_SEL 1,   B T S 2)
ZMK_LEADER_SEQUENCE(bts3,        &out BT_SEL 2,   B T S 3)
ZMK_LEADER_SEQUENCE(bts4,        &out BT_SEL 3,   B T S 4)
ZMK_LEADER_SEQUENCE(bts5,        &out BT_SEL 4,   B T S 5)

ZMK_LEADER_SEQUENCE(btd1,        &out BT_DISC 0,   B T D 1)
ZMK_LEADER_SEQUENCE(btd2,        &out BT_DISC 1,   B T D 2)
ZMK_LEADER_SEQUENCE(btd3,        &out BT_DISC 2,   B T D 3)
ZMK_LEADER_SEQUENCE(btd4,        &out BT_DISC 3,   B T D 4)
ZMK_LEADER_SEQUENCE(btd5,        &out BT_DISC 4,   B T D 5)

ZMK_LEADER_SEQUENCE(btcl,        &out BT_CLR,   B T C L)
ZMK_LEADER_SEQUENCE(btcl,        &out BT_CLR,   B T A L L)

#endif // CONFIG_WIRELESS

ZMK_LEADER_SEQUENCE(reset,   &sys_reset,     R E S E T)
ZMK_LEADER_SEQUENCE(boot,    &bootloader,    B O O T)
ZMK_LEADER_SEQUENCE(unlock,  &studio_unlock, U N L)
ZMK_LEADER_SEQUENCE(off,     &soft_off,      O F F)

ZMK_LEADER_SEQUENCE(base,    &to BASE,    B A S E)
ZMK_LEADER_SEQUENCE(rleft,    &to RLEFT,    L E F)
ZMK_LEADER_SEQUENCE(rright,    &to RRIGHT,    R I G)

#define TEXT(NAME,BINDINGS) \
/ { \
  macros { \
    NAME: NAME { \
      compatible = "zmk,behavior-macro"; \
      #binding-cells = <0>; \
      wait-ms = <30>; \
      tap-ms = <40>; \
      bindings = BINDINGS; \
      }; \
   }; \
};

#define COM ,

#define SPACE COM &kp SPACE

#define FCAP (key) \
     <&macro_press &kp LSHFT> \
     COM <&macro_tap &kp key> \
     COM <&macro_release &kp LSHFT>

#define CAP(key) \
     COM FCAP(key)

#define W5(K1, K2, K3, K4, K5, K6) \
  COM <&macro_tap &kp K1 &kp K2 &kp K3 &kp K4 &kp K5 &kp K6>

#define W3(K1, K2, K3) \
  COM <&macro_tap &kp K1 &kp K2 &kp K3>
#define W5(K1, K2, K3, K4, K5)
  COM <&macro_tap &kp K1 &kp K2 &kp K3 &kp K4 &kp K5>
#define W6(K1, K2, K3, K4, K5, K6)
  COM <&macro_tap &kp K1 &kp K2 &kp K3 &kp K4 &kp K5 &kp K6>

#define LTEXT(NAME, SEQ, BINDINGS) \
  TEXT(NAME, BINDINGS) \
  ZMK_LEADER_SEQUENCE(NAME, &NAME, SEQ)

// Michiel
LTEXT(me, M E,
      FCAP(M) W6(I, C, H, I, E, L))

// Michiel van Oosten
LTEXT(mvo, M V O,
     FCAP(M) W6(I, C, H, I, E, L) SPACE W3(V, A, N) SPACE CAP(O) W5(O, S, T, E, R))
