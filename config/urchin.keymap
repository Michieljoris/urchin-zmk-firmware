#include <behaviors.dtsi>
#include <dt-bindings/zmk/keys.h>
#include <dt-bindings/zmk/bt.h>
#include <dt-bindings/zmk/outputs.h>

#include "helper.h"
#include "key-labels.h"

// Keys definitions
#define _BT_SEL_KEYS_ &bt BT_SEL 0 &bt BT_SEL 1 &bt BT_SEL 2 &bt BT_SEL 3 &bt BT_CLR

// Layer definitions
#define BASE 0
#define MODS 1
#define BMIRROR 2
#define ALEFT 3
#define ARIGHT 4
#define AMOUSE 5
#define SETTINGS 6

#define XXX &none
#define ___ &trans

#define QUICK_TAP_MS 175


/ {
    behaviors {
        my_soft_off: z_so_off {
            compatible = "zmk,behavior-soft-off";
            #binding-cells = <0>;
            split-peripheral-off-on-press;
        };
    };
};



/ {
    soft_off_wakers {
        compatible = "zmk,soft-off-wakeup-sources";
        wakeup-sources = <&kscan0>;
    };
};

/* / { */
/*     combos { */
/*         soft_off_waker_combo_l { */
/*             timeout-ms = <50>; */
/*             key-positions = <LT4 LH0>;  // update with the positions of the keys you want */
/*             bindings = <&soft_off_waker>; */
/*         }; */
/*     }; */
/* }; */

/* / { */
/*     combos { */
/*         soft_off_waker_combo_r { */
/*             timeout-ms = <50>; */
/*             key-positions = <RT4 RH0>;  // update with the positions of the keys you want */
/*             bindings = <&soft_off_waker>; */
/*         }; */
/*     }; */
/* }; */

&lt { // layer-tap
  flavor = "balanced";
  tapping-term-ms = <200>;
  quick-tap-ms = <QUICK_TAP_MS>;
};

&mt { // layer-tap
  quick-tap-ms = <QUICK_TAP_MS>;
};

#define MAKE_HRM(NAME, HOLD, TAP, TRIGGER_POS)                                 \
  ZMK_HOLD_TAP(NAME, bindings = <HOLD>, <TAP>; flavor = "balanced";            \
               tapping-term-ms = <280>; quick-tap-ms = <QUICK_TAP_MS>;         \
               require-prior-idle-ms = <150>; hold-trigger-on-release;         \
               hold-trigger-key-positions = <TRIGGER_POS>;)

MAKE_HRM(hml, &kp, &kp, KEYS_R THUMBS) // Left-hand HRMs.
MAKE_HRM(hmr, &kp, &kp, KEYS_L THUMBS) // Right-hand HRMs.

#define AS(keycode) &as LS(keycode) keycode     // Autoshift Macro

/ {
    behaviors {
        as: auto_shift {
            compatible = "zmk,behavior-hold-tap";
            #binding-cells = <2>;
            tapping_term_ms = <135>;
            quick_tap_ms = <200>;
            flavor = "tap-preferred";
            bindings = <&kp>, <&kp>;
        };
    };
};

#define MO_SL(layer) &mo_sl layer layer

/ {
    behaviors {
        mo_sl: mo_sl {
            compatible = "zmk,behavior-hold-tap";
            #binding-cells = <2>;
            flavor = "hold-preferred";
            quick_tap_ms = <0>;
            tapping-term-ms = <200>;
            bindings = <&mo>, <&sl>;
            display-name = "Mo-Sl";
        };
    };
};


#include "leader.dtsi"
#include "combos.dtsi" // Must be sourced after HRM-combo hack.
#include "mouse.dtsi"

#ifndef ZMK_BASE_LAYER
#define ZMK_BASE_LAYER(name, LT, RT, LM, RM, LB, RB, LH, RH)  \
      ZMK_LAYER(name, LT RT LM RM LB RB LH RH)
#endif

//https://zmk.dev/docs/keymaps/list-of-keycodes

// BASE
ZMK_BASE_LAYER(Base,
      AS(Q)       AS(W)         AS(E)  AS(R)  AS(T)   ,   AS(Y)     AS(U)  AS(I)       AS(O)    AS(P)     ,
      AS(A)       AS(S)         AS(D)  AS(F)  AS(G)   ,   AS(H)     AS(J)  AS(K)        AS(L)   AS(SEMICOLON) ,
      AS(Z)       AS(X)         AS(C)  AS(V)  AS(B)   ,   AS(N)     AS(M)  AS(COMMA)    AS(DOT) AS(SLASH)      ,
             &mo_sl BMIRROR MODS   &mt LG(LC(LALT)) SPC, &mt LG(LC(LALT)) SPC &mo_sl BMIRROR MODS
      )


//MODS
ZMK_BASE_LAYER(Mods,
    XXX        XXX        &kp C_BRI_DN &kp C_BRI_UP XXX , XXX &kp C_VOL_UP &kp C_VOL_DN &kp C_MUTE &kp C_PP   ,
    &sk LSHIFT &sl ARIGHT &sk LALT     &sk LCTRL    XXX , XXX &sk LCTRL    &sk LALT     &sl ALEFT   &sk RSHIFT ,
    XXX        &sl AMOUSE  XXX          &sk LGUI     XXX , XXX &sk LGUI     XXX          XXX         XXX       ,
                       XXX   XXX   , XXX XXX
      )

//BMIRROR
ZMK_BASE_LAYER(Mirrored,
    AS(P)          AS(O)    AS(I)      AS(U)  AS(Y) , AS(T) AS(R) AS(E) AS(W) AS(Q) ,
   AS(SEMICOLON)  AS(L)    AS(K)      AS(J)  AS(H)  , AS(G) AS(F) AS(D) AS(S) AS(A) ,
    AS(SLASH)      AS(DOT)  AS(COMMA)  AS(M)  AS(N) , AS(B) AS(V) AS(C) AS(X) AS(Z) ,
                   ___ ___ , ___  ___
      )

//LEFT nav layer
ZMK_BASE_LAYER(Left,
    XXX      XXX         XXX           XXX     XXX ,  XXX   &kp C_VOL_UP &kp C_VOL_DN  &kp C_MUTE &kp C_PP   ,
    &kp HOME &kp PAGE_UP &kp PAGE_DOWN &kp END XXX ,  XXX   &kp LCTRL    &kp LALT      XXX        &kp RSHIFT ,
    XXX      XXX         XXX           XXX     XXX ,  XXX   &kp LGUI    XXX          XXX        XXX        ,
                                   &kp DEL &kp DEL ,   &kp DEL &kp DEL
                 )

//RIGHT cursor keys and symbols layer
ZMK_BASE_LAYER(Right,
    XXX         XXX      &kp C_BRI_DN  &kp C_BRI_UP  XXX   ,   &kp GRAVE &kp MINUS  &kp EQUAL  &kp BSPC  &kp BACKSLASH ,
    &kp LSHIFT  XXX      &kp LALT      &kp LCTRL     XXX   ,   &kp LEFT  &kp DOWN   &kp UP     &kp RIGHT &kp SQT       ,
    XXX         XXX      XXX           &kp LGUI      XXX   ,   XXX       &kp LS(N9) &kp LBKT   &kp RBKT  &kp LS(N0)    ,
                                         &kp BSPC &kp BSPC ,   &kp BSPC &kp BSPC
)

//MOUSE
ZMK_BASE_LAYER(Mouse,
    XXX  XXX  XXX  XXX  XXX  ,  XXX     XXX       U_MS_U     XXX       U_WH_U  ,
    XXX  XXX  XXX  XXX  XXX  ,  U_WH_L  U_MS_L    U_MS_D     U_MS_R    U_WH_R  ,
    XXX  XXX  XXX  XXX  XXX  ,  XXX     &mkp LCLK &mkp MCLK  &mkp RCLK U_WH_D  ,
                    XXX  XXX ,  XXX   XXX
)

// SETTINGS
ZMK_BASE_LAYER(Settings,
   &studio_unlock &out OUT_USB   &out OUT_BLE  &my_soft_off     &sys_reset   , &sys_reset    &hw_soft_off     XXX           XXX          &studio_unlock ,
   &bt BT_SEL 0   &bt BT_SEL 1   &bt BT_SEL 2  &bt BT_SEL 3 &bt BT_SEL 4 , &bt BT_DISC 0 &bt BT_DISC 1 &bt BT_DISC 2 &bt BT_DISC 3 &bt BT_DISC 4      ,
   &bt BT_CLR     &bt BT_CLR_ALL &to BMIRROR   XXX          &bootloader  , &bootloader   XXX          &to BMIRROR   XXX           XXX ,
                                                     &to BASE &to BASE ,  &to BASE &to BASE
)
